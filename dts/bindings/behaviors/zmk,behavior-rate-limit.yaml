## dts/bindings/behaviors/zmk,behavior-rate-limit.yaml
```yaml
description: Set rate limit in runtime
compatible: "zmk,behavior-rate-limit"
include: one_param.yaml

properties:
  values-ms:
    type: array
    required: true
  feedback-gpios:
    type: phandle-array
  feedback-extra-gpios:
    type: phandle-array
  feedback-wrap-pattern:
    type: array
  feedback-duration:
    type: int
    default: 0
```

## dts/bindings/input_processors/zmk,input-processor-report-rate-limit.yaml
```yaml
# Copyright (c) 2024, The ZMK Contributors
# SPDX-License-Identifier: MIT

description: Input Processor for limiting the rate of input reports
compatible: "zmk,input-processor-report-rate-limit"
include: ip_zero_param.yaml

properties:
  type:
    type: int
  codes:
    type: array
    required: true
  limit-ble-only:
    type: boolean
```

## src/behaviors/Kconfig
```kconfig
# Copyright (c) 2023 The ZMK Contributors
# SPDX-License-Identifier: MIT

if ZMK_POINTING

config ZIP_RATE_LIMIT_MAX_DEVICES
  int "Maximum rate limit behaviors"
  default 3

config ZIP_RATE_LIMIT_MAX_ARR_VALUES
  int "Maximum items in dts arrays"
  default 8

endif # ZMK_POINTER_2S_MIXER
```

## src/mouse/Kconfig
```kconfig
# Copyright (c) 2023 The ZMK Contributors
# SPDX-License-Identifier: MIT

if ZMK_POINTING

config ZMK_INPUT_PROCESSOR_REPORT_RATE_LIMIT
    bool "Report Rate Limit Input Processor"
    default y
    depends on DT_HAS_ZMK_INPUT_PROCESSOR_REPORT_RATE_LIMIT_ENABLED

endif
```

## src/pointing/Kconfig
```kconfig
# Copyright (c) 2023 The ZMK Contributors
# SPDX-License-Identifier: MIT

if ZMK_POINTING

config ZMK_INPUT_PROCESSOR_REPORT_RATE_LIMIT
    bool "Rate limiter"
    default y
    depends on DT_HAS_ZMK_INPUT_PROCESSOR_REPORT_RATE_LIMIT_ENABLED

config ZMK_INPUT_PROCESSOR_REPORT_RATE_LIMIT_DEFAULT
    int "Default limit (delay between transmissions, msec)"
    default 8

endif
```
